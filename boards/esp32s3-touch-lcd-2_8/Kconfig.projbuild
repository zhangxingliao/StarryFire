## components/sf_hal/Kconfig
```kconfig
menu "HAL Drivers"
    config SF_HAL_DISPLAY_ST7789
        bool "ST7789 display driver"
        default y
        help
            Enable ST7789 SPI LCD controller driver.

    config SF_HAL_INPUT_TOUCH_CST328
        bool "CST328 touch driver"
        default n
        help
            Enable CST328 capacitive touch controller driver (I2C).

    config SF_HAL_DISPLAY_WIDTH
        int "Display horizontal resolution"
        default 240
        range 0 480
        help
            LCD panel width in pixels.

    config SF_HAL_DISPLAY_HEIGHT
        int "Display vertical resolution"
        default 320
        range 0 480
        help
            LCD panel height in pixels.

    config SF_HAL_DISPLAY_CMD_BITS
        int "Display SPI command phase bits"
        default 8
        range 4 16
        help
            SPI command phase width for the LCD panel interface.

    config SF_HAL_DISPLAY_PARAM_BITS
        int "Display SPI parameter phase bits"
        default 8
        range 4 16
        help
            SPI parameter phase width for the LCD panel interface.

    config SF_HAL_DISPLAY_BL_ON_LEVEL
        int "Backlight active level (0 = low, 1 = high)"
        default 1
        range 0 1
        help
            Level that turns the backlight on for this panel.

    config SF_HAL_DISPLAY_PIXEL_CLOCK_HZ
        int "Display SPI pixel clock (Hz)"
        default 80000000
        range 1000000 120000000
        help
            SPI clock frequency for LCD communication.
endmenu
```

## components/sf_sys/Kconfig
```kconfig
menu "System Services"

    config SF_SYS_MAX_REGISTERED_APPS
        int "Max registered App slots"
        default 16
        range 1 32
        help
            Maximum number of App entries in the static registration table.

    config SF_SYS_MAX_PAUSED_APPS
        int "Max paused (background) Apps"
        default 2
        range 0 8
        help
            How many Apps can stay in PAUSED state simultaneously.
            Beyond this limit, the least-recently-used PAUSED App
            is stopped (STOPPED → DESTROYED).

    config SF_SYS_EVENT_SUBSCRIBERS_PER_EVENT
        int "Max subscribers per Event ID"
        default 8
        range 1 16
        help
            How many callbacks can subscribe to the same Event ID.

endmenu
```
